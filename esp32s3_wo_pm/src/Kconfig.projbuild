## esp32s3_wo_pm/src/Kconfig.projbuild
```kconfig
menu "Example Configuration"

    config WIFI_SSID
        depends on !EXAMPLE_WIFI_SSID_PWD_FROM_STDIN
        string "WiFi SSID"
        default "myssid"
        help
            SSID (network name) for the example to connect to.

    config WIFI_PASSWORD
        depends on !EXAMPLE_WIFI_SSID_PWD_FROM_STDIN
        string "WiFi Password"
        default "mypassword"
        help
            WiFi password (WPA or WPA2) for the example to use.
            Can be left blank if the network has no security set.

    config BROKER_URI
        string "Broker URI"
        default "mqtts://192.168.1.40"
        help
            URI of the broker to connect to

    config BROKER_URI_FROM_STDIN
        bool
        default y if BROKER_URI = "FROM_STDIN"

    config ACCESS_TOKEN
        string "Access Token"
        default ""
        help
            Access token to connect to broker

    config ACCESS_TOKEN_FROM_STDIN
        bool
        default y if ACCESS_TOKEN = "FROM_STDIN"

    config I2CDEV_TIMEOUT
        int "I2C timeout"
        default "100000"
        help
            I2C device timeout
        
    config I2C_FREQ_HZ
    int "I2C bus frequency"
    default "400000"
    help
        I2C bus frequency, default 400kHz
          
endmenu
```
